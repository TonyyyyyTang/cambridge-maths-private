## audits/analysis-ii-course-2026-11/sample.yaml
```yaml
course: IB/analysis-ii
population: 292
strata:
  sheet:
    population: 124
    sampled: 25
  tripos:
    population: 168
    sampled: 34
seed: 20261203
method: random.Random(seed).sample per stratum (sheet, then tripos), each ceil(20%),
  population sorted by id; population = ai-draft units with course or also_courses
  equal to the course
sample:
- id: IB/analysis-ii/sheet-2/qx80
  unit_dir: courses/IB/analysis-ii/sheets/sheet-2/qx80
  packet: packets/IB_analysis-ii_sheet-2_qx80.md
  rework: rework/IB_analysis-ii_sheet-2_qx80.md
- id: IB/analysis-ii/sheet-2/q01
  unit_dir: courses/IB/analysis-ii/sheets/sheet-2/q01
  packet: packets/IB_analysis-ii_sheet-2_q01.md
  rework: rework/IB_analysis-ii_sheet-2_q01.md
- id: IB/analysis-ii/sheet-1/q06
  unit_dir: courses/IB/analysis-ii/sheets/sheet-1/q06
  packet: packets/IB_analysis-ii_sheet-1_q06.md
  rework: rework/IB_analysis-ii_sheet-1_q06.md
- id: IB/analysis-ii/sheet-2/qx82
  unit_dir: courses/IB/analysis-ii/sheets/sheet-2/qx82
  packet: packets/IB_analysis-ii_sheet-2_qx82.md
  rework: rework/IB_analysis-ii_sheet-2_qx82.md
- id: IB/analysis-ii/sheet-2/q07
  unit_dir: courses/IB/analysis-ii/sheets/sheet-2/q07
  packet: packets/IB_analysis-ii_sheet-2_q07.md
  rework: rework/IB_analysis-ii_sheet-2_q07.md
- id: IB/analysis-ii/sheet-2/qx07
  unit_dir: courses/IB/analysis-ii/sheets/sheet-2/qx07
  packet: packets/IB_analysis-ii_sheet-2_qx07.md
  rework: rework/IB_analysis-ii_sheet-2_qx07.md
- id: IB/analysis-ii/sheet-2/qx02
  unit_dir: courses/IB/analysis-ii/sheets/sheet-2/qx02
  packet: packets/IB_analysis-ii_sheet-2_qx02.md
  rework: rework/IB_analysis-ii_sheet-2_qx02.md
- id: IB/analysis-ii/sheet-2/qx86
  unit_dir: courses/IB/analysis-ii/sheets/sheet-2/qx86
  packet: packets/IB_analysis-ii_sheet-2_qx86.md
  rework: rework/IB_analysis-ii_sheet-2_qx86.md
- id: IB/analysis-ii/sheet-1/q11
  unit_dir: courses/IB/analysis-ii/sheets/sheet-1/q11
  packet: packets/IB_analysis-ii_sheet-1_q11.md
  rework: rework/IB_analysis-ii_sheet-1_q11.md
- id: IB/analysis-ii/sheet-2/qx37
  unit_dir: courses/IB/analysis-ii/sheets/sheet-2/qx37
  packet: packets/IB_analysis-ii_sheet-2_qx37.md
  rework: rework/IB_analysis-ii_sheet-2_qx37.md
- id: IB/analysis-ii/sheet-2/qx14
  unit_dir: courses/IB/analysis-ii/sheets/sheet-2/qx14
  packet: packets/IB_analysis-ii_sheet-2_qx14.md
  rework: rework/IB_analysis-ii_sheet-2_qx14.md
- id: IB/analysis-ii/sheet-2/qx90
  unit_dir: courses/IB/analysis-ii/sheets/sheet-2/qx90
  packet: packets/IB_analysis-ii_sheet-2_qx90.md
  rework: rework/IB_analysis-ii_sheet-2_qx90.md
- id: IB/analysis-ii/sheet-2/qx76
  unit_dir: courses/IB/analysis-ii/sheets/sheet-2/qx76
  packet: packets/IB_analysis-ii_sheet-2_qx76.md
  rework: rework/IB_analysis-ii_sheet-2_qx76.md
- id: IB/analysis-ii/sheet-1/q12
  unit_dir: courses/IB/analysis-ii/sheets/sheet-1/q12
  packet: packets/IB_analysis-ii_sheet-1_q12.md
  rework: rework/IB_analysis-ii_sheet-1_q12.md
- id: IB/analysis-ii/sheet-2/qx49
  unit_dir: courses/IB/analysis-ii/sheets/sheet-2/qx49
  packet: packets/IB_analysis-ii_sheet-2_qx49.md
  rework: rework/IB_analysis-ii_sheet-2_qx49.md
- id: IB/analysis-ii/sheet-2/qx36
  unit_dir: courses/IB/analysis-ii/sheets/sheet-2/qx36
  packet: packets/IB_analysis-ii_sheet-2_qx36.md
  rework: rework/IB_analysis-ii_sheet-2_qx36.md
- id: IB/analysis-ii/sheet-2/qx22
  unit_dir: courses/IB/analysis-ii/sheets/sheet-2/qx22
  packet: packets/IB_analysis-ii_sheet-2_qx22.md
  rework: rework/IB_analysis-ii_sheet-2_qx22.md
- id: IB/analysis-ii/sheet-2/qx24
  unit_dir: courses/IB/analysis-ii/sheets/sheet-2/qx24
  packet: packets/IB_analysis-ii_sheet-2_qx24.md
  rework: rework/IB_analysis-ii_sheet-2_qx24.md
- id: IB/analysis-ii/sheet-2/qx56
  unit_dir: courses/IB/analysis-ii/sheets/sheet-2/qx56
  packet: packets/IB_analysis-ii_sheet-2_qx56.md
  rework: rework/IB_analysis-ii_sheet-2_qx56.md
- id: IB/analysis-ii/sheet-2/qx62
  unit_dir: courses/IB/analysis-ii/sheets/sheet-2/qx62
  packet: packets/IB_analysis-ii_sheet-2_qx62.md
  rework: rework/IB_analysis-ii_sheet-2_qx62.md
- id: IB/analysis-ii/sheet-2/qx55
  unit_dir: courses/IB/analysis-ii/sheets/sheet-2/qx55
  packet: packets/IB_analysis-ii_sheet-2_qx55.md
  rework: rework/IB_analysis-ii_sheet-2_qx55.md
- id: IB/analysis-ii/sheet-2/q04
  unit_dir: courses/IB/analysis-ii/sheets/sheet-2/q04
  packet: packets/IB_analysis-ii_sheet-2_q04.md
  rework: rework/IB_analysis-ii_sheet-2_q04.md
- id: IB/analysis-ii/sheet-2/qx63
  unit_dir: courses/IB/analysis-ii/sheets/sheet-2/qx63
  packet: packets/IB_analysis-ii_sheet-2_qx63.md
  rework: rework/IB_analysis-ii_sheet-2_qx63.md
- id: IB/analysis-ii/sheet-2/qx75
  unit_dir: courses/IB/analysis-ii/sheets/sheet-2/qx75
  packet: packets/IB_analysis-ii_sheet-2_qx75.md
  rework: rework/IB_analysis-ii_sheet-2_qx75.md
- id: IB/analysis-ii/sheet-2/qx84
  unit_dir: courses/IB/analysis-ii/sheets/sheet-2/qx84
  packet: packets/IB_analysis-ii_sheet-2_qx84.md
  rework: rework/IB_analysis-ii_sheet-2_qx84.md
- id: IB/2006/P2/q3F
  unit_dir: tripos/IB/2006/P2/q3F
  packet: packets/IB_2006_P2_q3F.md
  rework: rework/IB_2006_P2_q3F.md
- id: IB/2019/P4/q3E
  unit_dir: tripos/IB/2019/P4/q3E
  packet: packets/IB_2019_P4_q3E.md
  rework: rework/IB_2019_P4_q3E.md
- id: IB/2009/P3/q13E
  unit_dir: tripos/IB/2009/P3/q13E
  packet: packets/IB_2009_P3_q13E.md
  rework: rework/IB_2009_P3_q13E.md
- id: IB/2020/P1/q10E
  unit_dir: tripos/IB/2020/P1/q10E
  packet: packets/IB_2020_P1_q10E.md
  rework: rework/IB_2020_P1_q10E.md
- id: IB/2015/P3/q2G
  unit_dir: tripos/IB/2015/P3/q2G
  packet: packets/IB_2015_P3_q2G.md
  rework: rework/IB_2015_P3_q2G.md
- id: IB/2018/P4/q12F
  unit_dir: tripos/IB/2018/P4/q12F
  packet: packets/IB_2018_P4_q12F.md
  rework: rework/IB_2018_P4_q12F.md
- id: IB/2005/P1/q11B
  unit_dir: tripos/IB/2005/P1/q11B
  packet: packets/IB_2005_P1_q11B.md
  rework: rework/IB_2005_P1_q11B.md
- id: IB/2013/P4/q3F
  unit_dir: tripos/IB/2013/P4/q3F
  packet: packets/IB_2013_P4_q3F.md
  rework: rework/IB_2013_P4_q3F.md
- id: IB/2002/P1/q1E
  unit_dir: tripos/IB/2002/P1/q1E
  packet: packets/IB_2002_P1_q1E.md
  rework: rework/IB_2002_P1_q1E.md
- id: IB/2025/P4/q10G
  unit_dir: tripos/IB/2025/P4/q10G
  packet: packets/IB_2025_P4_q10G.md
  rework: rework/IB_2025_P4_q10G.md
- id: IB/2018/P3/q12F
  unit_dir: tripos/IB/2018/P3/q12F
  packet: packets/IB_2018_P3_q12F.md
  rework: rework/IB_2018_P3_q12F.md
- id: IB/2016/P3/q12G
  unit_dir: tripos/IB/2016/P3/q12G
  packet: packets/IB_2016_P3_q12G.md
  rework: rework/IB_2016_P3_q12G.md
- id: IB/2025/P2/q2G
  unit_dir: tripos/IB/2025/P2/q2G
  packet: packets/IB_2025_P2_q2G.md
  rework: rework/IB_2025_P2_q2G.md
- id: IB/2016/P1/q11G
  unit_dir: tripos/IB/2016/P1/q11G
  packet: packets/IB_2016_P1_q11G.md
  rework: rework/IB_2016_P1_q11G.md
- id: IB/2001/P1/q10A
  unit_dir: tripos/IB/2001/P1/q10A
  packet: packets/IB_2001_P1_q10A.md
  rework: rework/IB_2001_P1_q10A.md
- id: IB/2022/P1/q10G
  unit_dir: tripos/IB/2022/P1/q10G
  packet: packets/IB_2022_P1_q10G.md
  rework: rework/IB_2022_P1_q10G.md
- id: IB/2026/P2/q10F
  unit_dir: tripos/IB/2026/P2/q10F
  packet: packets/IB_2026_P2_q10F.md
  rework: rework/IB_2026_P2_q10F.md
- id: IB/2006/P1/q11F
  unit_dir: tripos/IB/2006/P1/q11F
  packet: packets/IB_2006_P1_q11F.md
  rework: rework/IB_2006_P1_q11F.md
- id: IB/2010/P3/q12G
  unit_dir: tripos/IB/2010/P3/q12G
  packet: packets/IB_2010_P3_q12G.md
  rework: rework/IB_2010_P3_q12G.md
- id: IB/2010/P2/q4H
  unit_dir: tripos/IB/2010/P2/q4H
  packet: packets/IB_2010_P2_q4H.md
  rework: rework/IB_2010_P2_q4H.md
- id: IB/2023/P3/q11G
  unit_dir: tripos/IB/2023/P3/q11G
  packet: packets/IB_2023_P3_q11G.md
  rework: rework/IB_2023_P3_q11G.md
- id: IB/2009/P1/q11E
  unit_dir: tripos/IB/2009/P1/q11E
  packet: packets/IB_2009_P1_q11E.md
  rework: rework/IB_2009_P1_q11E.md
- id: IB/2009/P4/q13E
  unit_dir: tripos/IB/2009/P4/q13E
  packet: packets/IB_2009_P4_q13E.md
  rework: rework/IB_2009_P4_q13E.md
- id: IB/2011/P3/q2E
  unit_dir: tripos/IB/2011/P3/q2E
  packet: packets/IB_2011_P3_q2E.md
  rework: rework/IB_2011_P3_q2E.md
- id: IB/2009/P2/q3E
  unit_dir: tripos/IB/2009/P2/q3E
  packet: packets/IB_2009_P2_q3E.md
  rework: rework/IB_2009_P2_q3E.md
- id: IB/2014/P4/q12F
  unit_dir: tripos/IB/2014/P4/q12F
  packet: packets/IB_2014_P4_q12F.md
  rework: rework/IB_2014_P4_q12F.md
- id: IB/2003/P1/q1F
  unit_dir: tripos/IB/2003/P1/q1F
  packet: packets/IB_2003_P1_q1F.md
  rework: rework/IB_2003_P1_q1F.md
- id: IB/2004/P3/q4F
  unit_dir: tripos/IB/2004/P3/q4F
  packet: packets/IB_2004_P3_q4F.md
  rework: rework/IB_2004_P3_q4F.md
- id: IB/2015/P2/q3G
  unit_dir: tripos/IB/2015/P2/q3G
  packet: packets/IB_2015_P2_q3G.md
  rework: rework/IB_2015_P2_q3G.md
- id: IB/2006/P4/q13F
  unit_dir: tripos/IB/2006/P4/q13F
  packet: packets/IB_2006_P4_q13F.md
  rework: rework/IB_2006_P4_q13F.md
- id: IB/2004/P2/q3G
  unit_dir: tripos/IB/2004/P2/q3G
  packet: packets/IB_2004_P2_q3G.md
  rework: rework/IB_2004_P2_q3G.md
- id: IB/2022/P3/q11G
  unit_dir: tripos/IB/2022/P3/q11G
  packet: packets/IB_2022_P3_q11G.md
  rework: rework/IB_2022_P3_q11G.md
- id: IB/2003/P4/q1F
  unit_dir: tripos/IB/2003/P4/q1F
  packet: packets/IB_2003_P4_q1F.md
  rework: rework/IB_2003_P4_q1F.md
- id: IB/2011/P3/q12E
  unit_dir: tripos/IB/2011/P3/q12E
  packet: packets/IB_2011_P3_q12E.md
  rework: rework/IB_2011_P3_q12E.md
```

## audits/complex-methods-course-2026-11/sample.yaml
```yaml
course: IB/complex-methods
population: 140
strata:
  sheet:
    population: 1
    sampled: 1
  tripos:
    population: 139
    sampled: 28
seed: 20261205
method: random.Random(seed).sample per stratum (sheet, then tripos), each ceil(20%),
  population sorted by id; population = ai-draft units with course or also_courses
  equal to the course
sample:
- id: IB/methods/sheet-3/qx26
  unit_dir: courses/IB/methods/sheets/sheet-3/qx26
  packet: packets/IB_methods_sheet-3_qx26.md
  rework: rework/IB_methods_sheet-3_qx26.md
- id: IB/2019/P3/q4D
  unit_dir: tripos/IB/2019/P3/q4D
  packet: packets/IB_2019_P3_q4D.md
  rework: rework/IB_2019_P3_q4D.md
- id: IB/2001/P4/q8F
  unit_dir: tripos/IB/2001/P4/q8F
  packet: packets/IB_2001_P4_q8F.md
  rework: rework/IB_2001_P4_q8F.md
- id: IB/2001/P4/q17F
  unit_dir: tripos/IB/2001/P4/q17F
  packet: packets/IB_2001_P4_q17F.md
  rework: rework/IB_2001_P4_q17F.md
- id: IB/2018/P4/q14A
  unit_dir: tripos/IB/2018/P4/q14A
  packet: packets/IB_2018_P4_q14A.md
  rework: rework/IB_2018_P4_q14A.md
- id: IB/2021/P4/q12B
  unit_dir: tripos/IB/2021/P4/q12B
  packet: packets/IB_2021_P4_q12B.md
  rework: rework/IB_2021_P4_q12B.md
- id: IB/2008/P1/q3C
  unit_dir: tripos/IB/2008/P1/q3C
  packet: packets/IB_2008_P1_q3C.md
  rework: rework/IB_2008_P1_q3C.md
- id: IB/2004/P3/q5E
  unit_dir: tripos/IB/2004/P3/q5E
  packet: packets/IB_2004_P3_q5E.md
  rework: rework/IB_2004_P3_q5E.md
- id: IB/2003/P4/q13E
  unit_dir: tripos/IB/2003/P4/q13E
  packet: packets/IB_2003_P4_q13E.md
  rework: rework/IB_2003_P4_q13E.md
- id: IB/2012/P1/q13A
  unit_dir: tripos/IB/2012/P1/q13A
  packet: packets/IB_2012_P1_q13A.md
  rework: rework/IB_2012_P1_q13A.md
- id: IB/2006/P1/q13D
  unit_dir: tripos/IB/2006/P1/q13D
  packet: packets/IB_2006_P1_q13D.md
  rework: rework/IB_2006_P1_q13D.md
- id: IB/2002/P1/q16B
  unit_dir: tripos/IB/2002/P1/q16B
  packet: packets/IB_2002_P1_q16B.md
  rework: rework/IB_2002_P1_q16B.md
- id: IB/2019/P1/q2F
  unit_dir: tripos/IB/2019/P1/q2F
  packet: packets/IB_2019_P1_q2F.md
  rework: rework/IB_2019_P1_q2F.md
- id: IB/2009/P4/q15D
  unit_dir: tripos/IB/2009/P4/q15D
  packet: packets/IB_2009_P4_q15D.md
  rework: rework/IB_2009_P4_q15D.md
- id: IB/2008/P4/q15C
  unit_dir: tripos/IB/2008/P4/q15C
  packet: packets/IB_2008_P4_q15C.md
  rework: rework/IB_2008_P4_q15C.md
- id: IB/2022/P1/q3G
  unit_dir: tripos/IB/2022/P1/q3G
  packet: packets/IB_2022_P1_q3G.md
  rework: rework/IB_2022_P1_q3G.md
- id: IB/2009/P2/q14D
  unit_dir: tripos/IB/2009/P2/q14D
  packet: packets/IB_2009_P2_q14D.md
  rework: rework/IB_2009_P2_q14D.md
- id: IB/2007/P1/q3F
  unit_dir: tripos/IB/2007/P1/q3F
  packet: packets/IB_2007_P1_q3F.md
  rework: rework/IB_2007_P1_q3F.md
- id: IB/2019/P1/q13F
  unit_dir: tripos/IB/2019/P1/q13F
  packet: packets/IB_2019_P1_q13F.md
  rework: rework/IB_2019_P1_q13F.md
- id: IB/2004/P4/q4E
  unit_dir: tripos/IB/2004/P4/q4E
  packet: packets/IB_2004_P4_q4E.md
  rework: rework/IB_2004_P4_q4E.md
- id: IB/2007/P2/q14F
  unit_dir: tripos/IB/2007/P2/q14F
  packet: packets/IB_2007_P2_q14F.md
  rework: rework/IB_2007_P2_q14F.md
- id: IB/2002/P4/q17B
  unit_dir: tripos/IB/2002/P4/q17B
  packet: packets/IB_2002_P4_q17B.md
  rework: rework/IB_2002_P4_q17B.md
- id: IB/2026/P3/q3C
  unit_dir: tripos/IB/2026/P3/q3C
  packet: packets/IB_2026_P3_q3C.md
  rework: rework/IB_2026_P3_q3C.md
- id: IB/2004/P2/q16A
  unit_dir: tripos/IB/2004/P2/q16A
  packet: packets/IB_2004_P2_q16A.md
  rework: rework/IB_2004_P2_q16A.md
- id: IB/2020/P1/q12G
  unit_dir: tripos/IB/2020/P1/q12G
  packet: packets/IB_2020_P1_q12G.md
  rework: rework/IB_2020_P1_q12G.md
- id: IB/2005/P4/q15F
  unit_dir: tripos/IB/2005/P4/q15F
  packet: packets/IB_2005_P4_q15F.md
  rework: rework/IB_2005_P4_q15F.md
- id: IB/2017/P3/q4A
  unit_dir: tripos/IB/2017/P3/q4A
  packet: packets/IB_2017_P3_q4A.md
  rework: rework/IB_2017_P3_q4A.md
- id: IB/2007/P1/q13F
  unit_dir: tripos/IB/2007/P1/q13F
  packet: packets/IB_2007_P1_q13F.md
  rework: rework/IB_2007_P1_q13F.md
- id: IB/2012/P1/q2A
  unit_dir: tripos/IB/2012/P1/q2A
  packet: packets/IB_2012_P1_q2A.md
  rework: rework/IB_2012_P1_q2A.md
```
