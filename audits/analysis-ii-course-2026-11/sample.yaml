## audits/numerical-analysis-course-2026-11/sample.yaml
```yaml
course: IB/numerical-analysis
population: 119
strata:
  sheet:
    population: 0
    sampled: 0
  tripos:
    population: 119
    sampled: 24
seed: 20261208
method: random.Random(seed).sample per stratum (sheet, then tripos), each ceil(20%),
  population sorted by id; population = ai-draft units with course or also_courses
  equal to the course
sample:
- id: IB/2015/P4/q8D
  unit_dir: tripos/IB/2015/P4/q8D
  packet: packets/IB_2015_P4_q8D.md
  rework: rework/IB_2015_P4_q8D.md
- id: IB/2006/P2/q18D
  unit_dir: tripos/IB/2006/P2/q18D
  packet: packets/IB_2006_P2_q18D.md
  rework: rework/IB_2006_P2_q18D.md
- id: IB/2020/P1/q18C
  unit_dir: tripos/IB/2020/P1/q18C
  packet: packets/IB_2020_P1_q18C.md
  rework: rework/IB_2020_P1_q18C.md
- id: IB/2002/P2/q14B
  unit_dir: tripos/IB/2002/P2/q14B
  packet: packets/IB_2002_P2_q14B.md
  rework: rework/IB_2002_P2_q14B.md
- id: IB/2016/P2/q19D
  unit_dir: tripos/IB/2016/P2/q19D
  packet: packets/IB_2016_P2_q19D.md
  rework: rework/IB_2016_P2_q19D.md
- id: IB/2024/P3/q17A
  unit_dir: tripos/IB/2024/P3/q17A
  packet: packets/IB_2024_P3_q17A.md
  rework: rework/IB_2024_P3_q17A.md
- id: IB/2026/P2/q17C
  unit_dir: tripos/IB/2026/P2/q17C
  packet: packets/IB_2026_P2_q17C.md
  rework: rework/IB_2026_P2_q17C.md
- id: IB/2012/P1/q18D
  unit_dir: tripos/IB/2012/P1/q18D
  packet: packets/IB_2012_P1_q18D.md
  rework: rework/IB_2012_P1_q18D.md
- id: IB/2010/P4/q8C
  unit_dir: tripos/IB/2010/P4/q8C
  packet: packets/IB_2010_P4_q8C.md
  rework: rework/IB_2010_P4_q8C.md
- id: IB/2004/P3/q22A
  unit_dir: tripos/IB/2004/P3/q22A
  packet: packets/IB_2004_P3_q22A.md
  rework: rework/IB_2004_P3_q22A.md
- id: IB/2018/P2/q19D
  unit_dir: tripos/IB/2018/P2/q19D
  packet: packets/IB_2018_P2_q19D.md
  rework: rework/IB_2018_P2_q19D.md
- id: IB/2014/P1/q6C
  unit_dir: tripos/IB/2014/P1/q6C
  packet: packets/IB_2014_P1_q6C.md
  rework: rework/IB_2014_P1_q6C.md
- id: IB/2008/P2/q18D
  unit_dir: tripos/IB/2008/P2/q18D
  packet: packets/IB_2008_P2_q18D.md
  rework: rework/IB_2008_P2_q18D.md
- id: IB/2018/P1/q18D
  unit_dir: tripos/IB/2018/P1/q18D
  packet: packets/IB_2018_P1_q18D.md
  rework: rework/IB_2018_P1_q18D.md
- id: IB/2016/P1/q18D
  unit_dir: tripos/IB/2016/P1/q18D
  packet: packets/IB_2016_P1_q18D.md
  rework: rework/IB_2016_P1_q18D.md
- id: IB/2016/P1/q6D
  unit_dir: tripos/IB/2016/P1/q6D
  packet: packets/IB_2016_P1_q6D.md
  rework: rework/IB_2016_P1_q6D.md
- id: IB/2024/P1/q5A
  unit_dir: tripos/IB/2024/P1/q5A
  packet: packets/IB_2024_P1_q5A.md
  rework: rework/IB_2024_P1_q5A.md
- id: IB/2019/P1/q6C
  unit_dir: tripos/IB/2019/P1/q6C
  packet: packets/IB_2019_P1_q6C.md
  rework: rework/IB_2019_P1_q6C.md
- id: IB/2019/P2/q19C
  unit_dir: tripos/IB/2019/P2/q19C
  packet: packets/IB_2019_P2_q19C.md
  rework: rework/IB_2019_P2_q19C.md
- id: IB/2018/P3/q19D
  unit_dir: tripos/IB/2018/P3/q19D
  packet: packets/IB_2018_P3_q19D.md
  rework: rework/IB_2018_P3_q19D.md
- id: IB/2009/P2/q18C
  unit_dir: tripos/IB/2009/P2/q18C
  packet: packets/IB_2009_P2_q18C.md
  rework: rework/IB_2009_P2_q18C.md
- id: IB/2017/P2/q19C
  unit_dir: tripos/IB/2017/P2/q19C
  packet: packets/IB_2017_P2_q19C.md
  rework: rework/IB_2017_P2_q19C.md
- id: IB/2014/P1/q18C
  unit_dir: tripos/IB/2014/P1/q18C
  packet: packets/IB_2014_P1_q18C.md
  rework: rework/IB_2014_P1_q18C.md
- id: IB/2017/P4/q8C
  unit_dir: tripos/IB/2017/P4/q8C
  packet: packets/IB_2017_P4_q8C.md
  rework: rework/IB_2017_P4_q8C.md
```

## audits/quantum-mechanics-course-2026-11/sample.yaml
```yaml
course: IB/quantum-mechanics
population: 181
strata:
  sheet:
    population: 52
    sampled: 11
  tripos:
    population: 129
    sampled: 26
seed: 20261202
method: random.Random(seed).sample per stratum (sheet, then tripos), each ceil(20%),
  population sorted by id; population = ai-draft units with course or also_courses
  equal to the course
sample:
- id: IB/quantum-mechanics/sheet-1/q11
  unit_dir: courses/IB/quantum-mechanics/sheets/sheet-1/q11
  packet: packets/IB_quantum-mechanics_sheet-1_q11.md
  rework: rework/IB_quantum-mechanics_sheet-1_q11.md
- id: IB/quantum-mechanics/sheet-3/q03
  unit_dir: courses/IB/quantum-mechanics/sheets/sheet-3/q03
  packet: packets/IB_quantum-mechanics_sheet-3_q03.md
  rework: rework/IB_quantum-mechanics_sheet-3_q03.md
- id: IB/quantum-mechanics/sheet-2/q02
  unit_dir: courses/IB/quantum-mechanics/sheets/sheet-2/q02
  packet: packets/IB_quantum-mechanics_sheet-2_q02.md
  rework: rework/IB_quantum-mechanics_sheet-2_q02.md
- id: IB/quantum-mechanics/sheet-1/q01
  unit_dir: courses/IB/quantum-mechanics/sheets/sheet-1/q01
  packet: packets/IB_quantum-mechanics_sheet-1_q01.md
  rework: rework/IB_quantum-mechanics_sheet-1_q01.md
- id: IB/quantum-mechanics/sheet-3/q10
  unit_dir: courses/IB/quantum-mechanics/sheets/sheet-3/q10
  packet: packets/IB_quantum-mechanics_sheet-3_q10.md
  rework: rework/IB_quantum-mechanics_sheet-3_q10.md
- id: IB/quantum-mechanics/sheet-1/q09
  unit_dir: courses/IB/quantum-mechanics/sheets/sheet-1/q09
  packet: packets/IB_quantum-mechanics_sheet-1_q09.md
  rework: rework/IB_quantum-mechanics_sheet-1_q09.md
- id: IB/quantum-mechanics/sheet-2/qx05
  unit_dir: courses/IB/quantum-mechanics/sheets/sheet-2/qx05
  packet: packets/IB_quantum-mechanics_sheet-2_qx05.md
  rework: rework/IB_quantum-mechanics_sheet-2_qx05.md
- id: IB/quantum-mechanics/sheet-1/qx05
  unit_dir: courses/IB/quantum-mechanics/sheets/sheet-1/qx05
  packet: packets/IB_quantum-mechanics_sheet-1_qx05.md
  rework: rework/IB_quantum-mechanics_sheet-1_qx05.md
- id: IB/quantum-mechanics/sheet-2/qx07
  unit_dir: courses/IB/quantum-mechanics/sheets/sheet-2/qx07
  packet: packets/IB_quantum-mechanics_sheet-2_qx07.md
  rework: rework/IB_quantum-mechanics_sheet-2_qx07.md
- id: IB/quantum-mechanics/sheet-3/q08
  unit_dir: courses/IB/quantum-mechanics/sheets/sheet-3/q08
  packet: packets/IB_quantum-mechanics_sheet-3_q08.md
  rework: rework/IB_quantum-mechanics_sheet-3_q08.md
- id: IB/quantum-mechanics/sheet-3/qx01
  unit_dir: courses/IB/quantum-mechanics/sheets/sheet-3/qx01
  packet: packets/IB_quantum-mechanics_sheet-3_qx01.md
  rework: rework/IB_quantum-mechanics_sheet-3_qx01.md
- id: IB/2016/P2/q17B
  unit_dir: tripos/IB/2016/P2/q17B
  packet: packets/IB_2016_P2_q17B.md
  rework: rework/IB_2016_P2_q17B.md
- id: IB/2025/P3/q6C
  unit_dir: tripos/IB/2025/P3/q6C
  packet: packets/IB_2025_P3_q6C.md
  rework: rework/IB_2025_P3_q6C.md
- id: IB/2015/P1/q15D
  unit_dir: tripos/IB/2015/P1/q15D
  packet: packets/IB_2015_P1_q15D.md
  rework: rework/IB_2015_P1_q15D.md
- id: IB/2001/P3/q20F
  unit_dir: tripos/IB/2001/P3/q20F
  packet: packets/IB_2001_P3_q20F.md
  rework: rework/IB_2001_P3_q20F.md
- id: IB/2023/P1/q14D
  unit_dir: tripos/IB/2023/P1/q14D
  packet: packets/IB_2023_P1_q14D.md
  rework: rework/IB_2023_P1_q14D.md
- id: IB/2009/P2/q16B
  unit_dir: tripos/IB/2009/P2/q16B
  packet: packets/IB_2009_P2_q16B.md
  rework: rework/IB_2009_P2_q16B.md
- id: IB/2017/P3/q16B
  unit_dir: tripos/IB/2017/P3/q16B
  packet: packets/IB_2017_P3_q16B.md
  rework: rework/IB_2017_P3_q16B.md
- id: IB/2004/P3/q20D
  unit_dir: tripos/IB/2004/P3/q20D
  packet: packets/IB_2004_P3_q20D.md
  rework: rework/IB_2004_P3_q20D.md
- id: IB/2026/P4/q15B
  unit_dir: tripos/IB/2026/P4/q15B
  packet: packets/IB_2026_P4_q15B.md
  rework: rework/IB_2026_P4_q15B.md
- id: IB/2002/P3/q20D
  unit_dir: tripos/IB/2002/P3/q20D
  packet: packets/IB_2002_P3_q20D.md
  rework: rework/IB_2002_P3_q20D.md
- id: IB/2026/P3/q6B
  unit_dir: tripos/IB/2026/P3/q6B
  packet: packets/IB_2026_P3_q6B.md
  rework: rework/IB_2026_P3_q6B.md
- id: IB/2002/P2/q9D
  unit_dir: tripos/IB/2002/P2/q9D
  packet: packets/IB_2002_P2_q9D.md
  rework: rework/IB_2002_P2_q9D.md
- id: IB/2018/P2/q17B
  unit_dir: tripos/IB/2018/P2/q17B
  packet: packets/IB_2018_P2_q17B.md
  rework: rework/IB_2018_P2_q17B.md
- id: IB/2025/P4/q4C
  unit_dir: tripos/IB/2025/P4/q4C
  packet: packets/IB_2025_P4_q4C.md
  rework: rework/IB_2025_P4_q4C.md
- id: IB/2008/P3/q7A
  unit_dir: tripos/IB/2008/P3/q7A
  packet: packets/IB_2008_P3_q7A.md
  rework: rework/IB_2008_P3_q7A.md
- id: IB/2017/P4/q6B
  unit_dir: tripos/IB/2017/P4/q6B
  packet: packets/IB_2017_P4_q6B.md
  rework: rework/IB_2017_P4_q6B.md
- id: IB/2018/P1/q15B
  unit_dir: tripos/IB/2018/P1/q15B
  packet: packets/IB_2018_P1_q15B.md
  rework: rework/IB_2018_P1_q15B.md
- id: IB/2010/P2/q17D
  unit_dir: tripos/IB/2010/P2/q17D
  packet: packets/IB_2010_P2_q17D.md
  rework: rework/IB_2010_P2_q17D.md
- id: IB/2013/P3/q16B
  unit_dir: tripos/IB/2013/P3/q16B
  packet: packets/IB_2013_P3_q16B.md
  rework: rework/IB_2013_P3_q16B.md
- id: IB/2011/P2/q17C
  unit_dir: tripos/IB/2011/P2/q17C
  packet: packets/IB_2011_P2_q17C.md
  rework: rework/IB_2011_P2_q17C.md
- id: IB/2006/P3/q16B
  unit_dir: tripos/IB/2006/P3/q16B
  packet: packets/IB_2006_P3_q16B.md
  rework: rework/IB_2006_P3_q16B.md
- id: IB/2012/P1/q15C
  unit_dir: tripos/IB/2012/P1/q15C
  packet: packets/IB_2012_P1_q15C.md
  rework: rework/IB_2012_P1_q15C.md
- id: IB/2023/P4/q15D
  unit_dir: tripos/IB/2023/P4/q15D
  packet: packets/IB_2023_P4_q15D.md
  rework: rework/IB_2023_P4_q15D.md
- id: IB/2014/P3/q16A
  unit_dir: tripos/IB/2014/P3/q16A
  packet: packets/IB_2014_P3_q16A.md
  rework: rework/IB_2014_P3_q16A.md
- id: IB/2008/P2/q16A
  unit_dir: tripos/IB/2008/P2/q16A
  packet: packets/IB_2008_P2_q16A.md
  rework: rework/IB_2008_P2_q16A.md
- id: IB/2011/P3/q8C
  unit_dir: tripos/IB/2011/P3/q8C
  packet: packets/IB_2011_P3_q8C.md
  rework: rework/IB_2011_P3_q8C.md
```

## audits/statistics-course-2026-11/sample.yaml
```yaml
course: IB/statistics
population: 131
strata:
  sheet:
    population: 0
    sampled: 0
  tripos:
    population: 131
    sampled: 27
seed: 20261209
method: random.Random(seed).sample per stratum (sheet, then tripos), each ceil(20%),
  population sorted by id; population = ai-draft units with course or also_courses
  equal to the course
sample:
- id: IB/2015/P1/q19H
  unit_dir: tripos/IB/2015/P1/q19H
  packet: packets/IB_2015_P1_q19H.md
  rework: rework/IB_2015_P1_q19H.md
- id: IB/2019/P2/q8H
  unit_dir: tripos/IB/2019/P2/q8H
  packet: packets/IB_2019_P2_q8H.md
  rework: rework/IB_2019_P2_q8H.md
- id: IB/2022/P1/q6H
  unit_dir: tripos/IB/2022/P1/q6H
  packet: packets/IB_2022_P1_q6H.md
  rework: rework/IB_2022_P1_q6H.md
- id: IB/2014/P2/q8H
  unit_dir: tripos/IB/2014/P2/q8H
  packet: packets/IB_2014_P2_q8H.md
  rework: rework/IB_2014_P2_q8H.md
- id: IB/2016/P3/q20H
  unit_dir: tripos/IB/2016/P3/q20H
  packet: packets/IB_2016_P3_q20H.md
  rework: rework/IB_2016_P3_q20H.md
- id: IB/2026/P1/q17H
  unit_dir: tripos/IB/2026/P1/q17H
  packet: packets/IB_2026_P1_q17H.md
  rework: rework/IB_2026_P1_q17H.md
- id: IB/2016/P1/q19H
  unit_dir: tripos/IB/2016/P1/q19H
  packet: packets/IB_2016_P1_q19H.md
  rework: rework/IB_2016_P1_q19H.md
- id: IB/2020/P1/q19H
  unit_dir: tripos/IB/2020/P1/q19H
  packet: packets/IB_2020_P1_q19H.md
  rework: rework/IB_2020_P1_q19H.md
- id: IB/2008/P3/q8H
  unit_dir: tripos/IB/2008/P3/q8H
  packet: packets/IB_2008_P3_q8H.md
  rework: rework/IB_2008_P3_q8H.md
- id: IB/2017/P4/q19H
  unit_dir: tripos/IB/2017/P4/q19H
  packet: packets/IB_2017_P4_q19H.md
  rework: rework/IB_2017_P4_q19H.md
- id: IB/2021/P1/q18H
  unit_dir: tripos/IB/2021/P1/q18H
  packet: packets/IB_2021_P1_q18H.md
  rework: rework/IB_2021_P1_q18H.md
- id: IB/2001/P2/q3D
  unit_dir: tripos/IB/2001/P2/q3D
  packet: packets/IB_2001_P2_q3D.md
  rework: rework/IB_2001_P2_q3D.md
- id: IB/2025/P2/q6H
  unit_dir: tripos/IB/2025/P2/q6H
  packet: packets/IB_2025_P2_q6H.md
  rework: rework/IB_2025_P2_q6H.md
- id: IB/2006/P1/q7C
  unit_dir: tripos/IB/2006/P1/q7C
  packet: packets/IB_2006_P1_q7C.md
  rework: rework/IB_2006_P1_q7C.md
- id: IB/2022/P2/q6H
  unit_dir: tripos/IB/2022/P2/q6H
  packet: packets/IB_2022_P2_q6H.md
  rework: rework/IB_2022_P2_q6H.md
- id: IB/2026/P3/q18H
  unit_dir: tripos/IB/2026/P3/q18H
  packet: packets/IB_2026_P3_q18H.md
  rework: rework/IB_2026_P3_q18H.md
- id: IB/2005/P1/q18D
  unit_dir: tripos/IB/2005/P1/q18D
  packet: packets/IB_2005_P1_q18D.md
  rework: rework/IB_2005_P1_q18D.md
- id: IB/2019/P1/q19H
  unit_dir: tripos/IB/2019/P1/q19H
  packet: packets/IB_2019_P1_q19H.md
  rework: rework/IB_2019_P1_q19H.md
- id: IB/2023/P3/q18H
  unit_dir: tripos/IB/2023/P3/q18H
  packet: packets/IB_2023_P3_q18H.md
  rework: rework/IB_2023_P3_q18H.md
- id: IB/2006/P1/q18C
  unit_dir: tripos/IB/2006/P1/q18C
  packet: packets/IB_2006_P1_q18C.md
  rework: rework/IB_2006_P1_q18C.md
- id: IB/2006/P2/q19C
  unit_dir: tripos/IB/2006/P2/q19C
  packet: packets/IB_2006_P2_q19C.md
  rework: rework/IB_2006_P2_q19C.md
- id: IB/2004/P2/q10H
  unit_dir: tripos/IB/2004/P2/q10H
  packet: packets/IB_2004_P2_q10H.md
  rework: rework/IB_2004_P2_q10H.md
- id: IB/2006/P4/q19C
  unit_dir: tripos/IB/2006/P4/q19C
  packet: packets/IB_2006_P4_q19C.md
  rework: rework/IB_2006_P4_q19C.md
- id: IB/2004/P4/q9H
  unit_dir: tripos/IB/2004/P4/q9H
  packet: packets/IB_2004_P4_q9H.md
  rework: rework/IB_2004_P4_q9H.md
- id: IB/2019/P1/q7H
  unit_dir: tripos/IB/2019/P1/q7H
  packet: packets/IB_2019_P1_q7H.md
  rework: rework/IB_2019_P1_q7H.md
- id: IB/2011/P1/q7H
  unit_dir: tripos/IB/2011/P1/q7H
  packet: packets/IB_2011_P1_q7H.md
  rework: rework/IB_2011_P1_q7H.md
- id: IB/2018/P2/q8H
  unit_dir: tripos/IB/2018/P2/q8H
  packet: packets/IB_2018_P2_q8H.md
  rework: rework/IB_2018_P2_q8H.md
```
