## audits/electromagnetism-course-2026-11/sample.yaml
```yaml
course: IB/electromagnetism
population: 115
strata:
  sheet:
    population: 1
    sampled: 1
  tripos:
    population: 114
    sampled: 23
seed: 20261206
method: random.Random(seed).sample per stratum (sheet, then tripos), each ceil(20%),
  population sorted by id; population = ai-draft units with course or also_courses
  equal to the course
sample:
- id: IB/methods/sheet-3/qx12
  unit_dir: courses/IB/methods/sheets/sheet-3/qx12
  packet: packets/IB_methods_sheet-3_qx12.md
  rework: rework/IB_methods_sheet-3_qx12.md
- id: IB/2023/P2/q4D
  unit_dir: tripos/IB/2023/P2/q4D
  packet: packets/IB_2023_P2_q4D.md
  rework: rework/IB_2023_P2_q4D.md
- id: IB/2010/P3/q17C
  unit_dir: tripos/IB/2010/P3/q17C
  packet: packets/IB_2010_P3_q17C.md
  rework: rework/IB_2010_P3_q17C.md
- id: IB/2020/P2/q5D
  unit_dir: tripos/IB/2020/P2/q5D
  packet: packets/IB_2020_P2_q5D.md
  rework: rework/IB_2020_P2_q5D.md
- id: IB/2026/P2/q16D
  unit_dir: tripos/IB/2026/P2/q16D
  packet: packets/IB_2026_P2_q16D.md
  rework: rework/IB_2026_P2_q16D.md
- id: IB/2011/P4/q7C
  unit_dir: tripos/IB/2011/P4/q7C
  packet: packets/IB_2011_P4_q7C.md
  rework: rework/IB_2011_P4_q7C.md
- id: IB/2017/P3/q17C
  unit_dir: tripos/IB/2017/P3/q17C
  packet: packets/IB_2017_P3_q17C.md
  rework: rework/IB_2017_P3_q17C.md
- id: IB/2024/P4/q5C
  unit_dir: tripos/IB/2024/P4/q5C
  packet: packets/IB_2024_P4_q5C.md
  rework: rework/IB_2024_P4_q5C.md
- id: IB/2012/P3/q17B
  unit_dir: tripos/IB/2012/P3/q17B
  packet: packets/IB_2012_P3_q17B.md
  rework: rework/IB_2012_P3_q17B.md
- id: IB/2013/P3/q17D
  unit_dir: tripos/IB/2013/P3/q17D
  packet: packets/IB_2013_P3_q17D.md
  rework: rework/IB_2013_P3_q17D.md
- id: IB/2023/P1/q15D
  unit_dir: tripos/IB/2023/P1/q15D
  packet: packets/IB_2023_P1_q15D.md
  rework: rework/IB_2023_P1_q15D.md
- id: IB/2010/P1/q16C
  unit_dir: tripos/IB/2010/P1/q16C
  packet: packets/IB_2010_P1_q16C.md
  rework: rework/IB_2010_P1_q16C.md
- id: IB/2004/P2/q18B
  unit_dir: tripos/IB/2004/P2/q18B
  packet: packets/IB_2004_P2_q18B.md
  rework: rework/IB_2004_P2_q18B.md
- id: IB/2015/P2/q6A
  unit_dir: tripos/IB/2015/P2/q6A
  packet: packets/IB_2015_P2_q6A.md
  rework: rework/IB_2015_P2_q6A.md
- id: IB/2020/P1/q16D
  unit_dir: tripos/IB/2020/P1/q16D
  packet: packets/IB_2020_P1_q16D.md
  rework: rework/IB_2020_P1_q16D.md
- id: IB/2011/P3/q17C
  unit_dir: tripos/IB/2011/P3/q17C
  packet: packets/IB_2011_P3_q17C.md
  rework: rework/IB_2011_P3_q17C.md
- id: IB/2005/P2/q17H
  unit_dir: tripos/IB/2005/P2/q17H
  packet: packets/IB_2005_P2_q17H.md
  rework: rework/IB_2005_P2_q17H.md
- id: IB/2015/P3/q17A
  unit_dir: tripos/IB/2015/P3/q17A
  packet: packets/IB_2015_P3_q17A.md
  rework: rework/IB_2015_P3_q17A.md
- id: IB/2016/P2/q6D
  unit_dir: tripos/IB/2016/P2/q6D
  packet: packets/IB_2016_P2_q6D.md
  rework: rework/IB_2016_P2_q6D.md
- id: IB/2020/P2/q15D
  unit_dir: tripos/IB/2020/P2/q15D
  packet: packets/IB_2020_P2_q15D.md
  rework: rework/IB_2020_P2_q15D.md
- id: IB/2012/P1/q16B
  unit_dir: tripos/IB/2012/P1/q16B
  packet: packets/IB_2012_P1_q16B.md
  rework: rework/IB_2012_P1_q16B.md
- id: IB/2019/P4/q7A
  unit_dir: tripos/IB/2019/P4/q7A
  packet: packets/IB_2019_P4_q7A.md
  rework: rework/IB_2019_P4_q7A.md
- id: IB/2024/P2/q16C
  unit_dir: tripos/IB/2024/P2/q16C
  packet: packets/IB_2024_P2_q16C.md
  rework: rework/IB_2024_P2_q16C.md
- id: IB/2007/P3/q17E
  unit_dir: tripos/IB/2007/P3/q17E
  packet: packets/IB_2007_P3_q17E.md
  rework: rework/IB_2007_P3_q17E.md
```

## audits/fluid-dynamics-course-2026-11/sample.yaml
```yaml
course: IB/fluid-dynamics
population: 132
strata:
  sheet:
    population: 0
    sampled: 0
  tripos:
    population: 132
    sampled: 27
seed: 20261207
method: random.Random(seed).sample per stratum (sheet, then tripos), each ceil(20%),
  population sorted by id; population = ai-draft units with course or also_courses
  equal to the course
sample:
- id: IB/2008/P1/q17B
  unit_dir: tripos/IB/2008/P1/q17B
  packet: packets/IB_2008_P1_q17B.md
  rework: rework/IB_2008_P1_q17B.md
- id: IB/2005/P2/q8E
  unit_dir: tripos/IB/2005/P2/q8E
  packet: packets/IB_2005_P2_q8E.md
  rework: rework/IB_2005_P2_q8E.md
- id: IB/2007/P3/q18D
  unit_dir: tripos/IB/2007/P3/q18D
  packet: packets/IB_2007_P3_q18D.md
  rework: rework/IB_2007_P3_q18D.md
- id: IB/2007/P2/q8D
  unit_dir: tripos/IB/2007/P2/q8D
  packet: packets/IB_2007_P2_q8D.md
  rework: rework/IB_2007_P2_q8D.md
- id: IB/2017/P1/q17D
  unit_dir: tripos/IB/2017/P1/q17D
  packet: packets/IB_2017_P1_q17D.md
  rework: rework/IB_2017_P1_q17D.md
- id: IB/2026/P4/q16A
  unit_dir: tripos/IB/2026/P4/q16A
  packet: packets/IB_2026_P4_q16A.md
  rework: rework/IB_2026_P4_q16A.md
- id: IB/2007/P4/q18D
  unit_dir: tripos/IB/2007/P4/q18D
  packet: packets/IB_2007_P4_q18D.md
  rework: rework/IB_2007_P4_q18D.md
- id: IB/2002/P4/q16C
  unit_dir: tripos/IB/2002/P4/q16C
  packet: packets/IB_2002_P4_q16C.md
  rework: rework/IB_2002_P4_q16C.md
- id: IB/2001/P3/q8G
  unit_dir: tripos/IB/2001/P3/q8G
  packet: packets/IB_2001_P3_q8G.md
  rework: rework/IB_2001_P3_q8G.md
- id: IB/2025/P3/q16D
  unit_dir: tripos/IB/2025/P3/q16D
  packet: packets/IB_2025_P3_q16D.md
  rework: rework/IB_2025_P3_q16D.md
- id: IB/2015/P3/q18B
  unit_dir: tripos/IB/2015/P3/q18B
  packet: packets/IB_2015_P3_q18B.md
  rework: rework/IB_2015_P3_q18B.md
- id: IB/2015/P1/q5B
  unit_dir: tripos/IB/2015/P1/q5B
  packet: packets/IB_2015_P1_q5B.md
  rework: rework/IB_2015_P1_q5B.md
- id: IB/2021/P2/q5A
  unit_dir: tripos/IB/2021/P2/q5A
  packet: packets/IB_2021_P2_q5A.md
  rework: rework/IB_2021_P2_q5A.md
- id: IB/2008/P1/q5B
  unit_dir: tripos/IB/2008/P1/q5B
  packet: packets/IB_2008_P1_q5B.md
  rework: rework/IB_2008_P1_q5B.md
- id: IB/2016/P3/q18C
  unit_dir: tripos/IB/2016/P3/q18C
  packet: packets/IB_2016_P3_q18C.md
  rework: rework/IB_2016_P3_q18C.md
- id: IB/2004/P1/q20C
  unit_dir: tripos/IB/2004/P1/q20C
  packet: packets/IB_2004_P1_q20C.md
  rework: rework/IB_2004_P1_q20C.md
- id: IB/2013/P4/q18A
  unit_dir: tripos/IB/2013/P4/q18A
  packet: packets/IB_2013_P4_q18A.md
  rework: rework/IB_2013_P4_q18A.md
- id: IB/2023/P3/q7C
  unit_dir: tripos/IB/2023/P3/q7C
  packet: packets/IB_2023_P3_q7C.md
  rework: rework/IB_2023_P3_q7C.md
- id: IB/2023/P1/q16C
  unit_dir: tripos/IB/2023/P1/q16C
  packet: packets/IB_2023_P1_q16C.md
  rework: rework/IB_2023_P1_q16C.md
- id: IB/2016/P2/q7C
  unit_dir: tripos/IB/2016/P2/q7C
  packet: packets/IB_2016_P2_q7C.md
  rework: rework/IB_2016_P2_q7C.md
- id: IB/2006/P1/q17A
  unit_dir: tripos/IB/2006/P1/q17A
  packet: packets/IB_2006_P1_q17A.md
  rework: rework/IB_2006_P1_q17A.md
- id: IB/2001/P1/q6G
  unit_dir: tripos/IB/2001/P1/q6G
  packet: packets/IB_2001_P1_q6G.md
  rework: rework/IB_2001_P1_q6G.md
- id: IB/2017/P1/q5D
  unit_dir: tripos/IB/2017/P1/q5D
  packet: packets/IB_2017_P1_q5D.md
  rework: rework/IB_2017_P1_q5D.md
- id: IB/2005/P1/q5E
  unit_dir: tripos/IB/2005/P1/q5E
  packet: packets/IB_2005_P1_q5E.md
  rework: rework/IB_2005_P1_q5E.md
- id: IB/2010/P2/q7B
  unit_dir: tripos/IB/2010/P2/q7B
  packet: packets/IB_2010_P2_q7B.md
  rework: rework/IB_2010_P2_q7B.md
- id: IB/2011/P1/q5B
  unit_dir: tripos/IB/2011/P1/q5B
  packet: packets/IB_2011_P1_q5B.md
  rework: rework/IB_2011_P1_q5B.md
- id: IB/2003/P4/q16C
  unit_dir: tripos/IB/2003/P4/q16C
  packet: packets/IB_2003_P4_q16C.md
  rework: rework/IB_2003_P4_q16C.md
```

## audits/linear-algebra-course-2026-11/sample.yaml
```yaml
course: IB/linear-algebra
population: 240
strata:
  sheet:
    population: 52
    sampled: 11
  tripos:
    population: 188
    sampled: 38
seed: 20261204
method: random.Random(seed).sample per stratum (sheet, then tripos), each ceil(20%),
  population sorted by id; population = ai-draft units with course or also_courses
  equal to the course
sample:
- id: IB/linear-algebra/sheet-4/q07
  unit_dir: courses/IB/linear-algebra/sheets/sheet-4/q07
  packet: packets/IB_linear-algebra_sheet-4_q07.md
  rework: rework/IB_linear-algebra_sheet-4_q07.md
- id: IB/linear-algebra/sheet-3/q08
  unit_dir: courses/IB/linear-algebra/sheets/sheet-3/q08
  packet: packets/IB_linear-algebra_sheet-3_q08.md
  rework: rework/IB_linear-algebra_sheet-3_q08.md
- id: IB/linear-algebra/sheet-1/q01
  unit_dir: courses/IB/linear-algebra/sheets/sheet-1/q01
  packet: packets/IB_linear-algebra_sheet-1_q01.md
  rework: rework/IB_linear-algebra_sheet-1_q01.md
- id: IB/linear-algebra/sheet-2/q11
  unit_dir: courses/IB/linear-algebra/sheets/sheet-2/q11
  packet: packets/IB_linear-algebra_sheet-2_q11.md
  rework: rework/IB_linear-algebra_sheet-2_q11.md
- id: IB/linear-algebra/sheet-1/q06
  unit_dir: courses/IB/linear-algebra/sheets/sheet-1/q06
  packet: packets/IB_linear-algebra_sheet-1_q06.md
  rework: rework/IB_linear-algebra_sheet-1_q06.md
- id: IB/linear-algebra/sheet-2/q02
  unit_dir: courses/IB/linear-algebra/sheets/sheet-2/q02
  packet: packets/IB_linear-algebra_sheet-2_q02.md
  rework: rework/IB_linear-algebra_sheet-2_q02.md
- id: IB/linear-algebra/sheet-1/q12
  unit_dir: courses/IB/linear-algebra/sheets/sheet-1/q12
  packet: packets/IB_linear-algebra_sheet-1_q12.md
  rework: rework/IB_linear-algebra_sheet-1_q12.md
- id: IB/linear-algebra/sheet-1/q07
  unit_dir: courses/IB/linear-algebra/sheets/sheet-1/q07
  packet: packets/IB_linear-algebra_sheet-1_q07.md
  rework: rework/IB_linear-algebra_sheet-1_q07.md
- id: IB/linear-algebra/sheet-3/q10
  unit_dir: courses/IB/linear-algebra/sheets/sheet-3/q10
  packet: packets/IB_linear-algebra_sheet-3_q10.md
  rework: rework/IB_linear-algebra_sheet-3_q10.md
- id: IB/linear-algebra/sheet-3/q12
  unit_dir: courses/IB/linear-algebra/sheets/sheet-3/q12
  packet: packets/IB_linear-algebra_sheet-3_q12.md
  rework: rework/IB_linear-algebra_sheet-3_q12.md
- id: IB/linear-algebra/sheet-4/q12
  unit_dir: courses/IB/linear-algebra/sheets/sheet-4/q12
  packet: packets/IB_linear-algebra_sheet-4_q12.md
  rework: rework/IB_linear-algebra_sheet-4_q12.md
- id: IB/2012/P2/q10F
  unit_dir: tripos/IB/2012/P2/q10F
  packet: packets/IB_2012_P2_q10F.md
  rework: rework/IB_2012_P2_q10F.md
- id: IB/2005/P1/q9C
  unit_dir: tripos/IB/2005/P1/q9C
  packet: packets/IB_2005_P1_q9C.md
  rework: rework/IB_2005_P1_q9C.md
- id: IB/2018/P4/q1E
  unit_dir: tripos/IB/2018/P4/q1E
  packet: packets/IB_2018_P4_q1E.md
  rework: rework/IB_2018_P4_q1E.md
- id: IB/2023/P1/q1F
  unit_dir: tripos/IB/2023/P1/q1F
  packet: packets/IB_2023_P1_q1F.md
  rework: rework/IB_2023_P1_q1F.md
- id: IB/2010/P4/q1F
  unit_dir: tripos/IB/2010/P4/q1F
  packet: packets/IB_2010_P4_q1F.md
  rework: rework/IB_2010_P4_q1F.md
- id: IB/2001/P2/q8B
  unit_dir: tripos/IB/2001/P2/q8B
  packet: packets/IB_2001_P2_q8B.md
  rework: rework/IB_2001_P2_q8B.md
- id: IB/2026/P4/q8G
  unit_dir: tripos/IB/2026/P4/q8G
  packet: packets/IB_2026_P4_q8G.md
  rework: rework/IB_2026_P4_q8G.md
- id: IB/2022/P2/q8F
  unit_dir: tripos/IB/2022/P2/q8F
  packet: packets/IB_2022_P2_q8F.md
  rework: rework/IB_2022_P2_q8F.md
- id: IB/2002/P2/q8F
  unit_dir: tripos/IB/2002/P2/q8F
  packet: packets/IB_2002_P2_q8F.md
  rework: rework/IB_2002_P2_q8F.md
- id: IB/2020/P2/q8F
  unit_dir: tripos/IB/2020/P2/q8F
  packet: packets/IB_2020_P2_q8F.md
  rework: rework/IB_2020_P2_q8F.md
- id: IB/2025/P4/q8F
  unit_dir: tripos/IB/2025/P4/q8F
  packet: packets/IB_2025_P4_q8F.md
  rework: rework/IB_2025_P4_q8F.md
- id: IB/2005/P2/q10C
  unit_dir: tripos/IB/2005/P2/q10C
  packet: packets/IB_2005_P2_q10C.md
  rework: rework/IB_2005_P2_q10C.md
- id: IB/2012/P2/q1F
  unit_dir: tripos/IB/2012/P2/q1F
  packet: packets/IB_2012_P2_q1F.md
  rework: rework/IB_2012_P2_q1F.md
- id: IB/2020/P1/q8F
  unit_dir: tripos/IB/2020/P1/q8F
  packet: packets/IB_2020_P1_q8F.md
  rework: rework/IB_2020_P1_q8F.md
- id: IB/2001/P1/q5C
  unit_dir: tripos/IB/2001/P1/q5C
  packet: packets/IB_2001_P1_q5C.md
  rework: rework/IB_2001_P1_q5C.md
- id: IB/2015/P4/q10E
  unit_dir: tripos/IB/2015/P4/q10E
  packet: packets/IB_2015_P4_q10E.md
  rework: rework/IB_2015_P4_q10E.md
- id: IB/2017/P1/q1F
  unit_dir: tripos/IB/2017/P1/q1F
  packet: packets/IB_2017_P1_q1F.md
  rework: rework/IB_2017_P1_q1F.md
- id: IB/2026/P3/q9G
  unit_dir: tripos/IB/2026/P3/q9G
  packet: packets/IB_2026_P3_q9G.md
  rework: rework/IB_2026_P3_q9G.md
- id: IB/2013/P2/q10E
  unit_dir: tripos/IB/2013/P2/q10E
  packet: packets/IB_2013_P2_q10E.md
  rework: rework/IB_2013_P2_q10E.md
- id: IB/2005/P4/q1B
  unit_dir: tripos/IB/2005/P4/q1B
  packet: packets/IB_2005_P4_q1B.md
  rework: rework/IB_2005_P4_q1B.md
- id: IB/2001/P1/q14C
  unit_dir: tripos/IB/2001/P1/q14C
  packet: packets/IB_2001_P1_q14C.md
  rework: rework/IB_2001_P1_q14C.md
- id: IB/2019/P2/q10F
  unit_dir: tripos/IB/2019/P2/q10F
  packet: packets/IB_2019_P2_q10F.md
  rework: rework/IB_2019_P2_q10F.md
- id: IB/2009/P2/q1G
  unit_dir: tripos/IB/2009/P2/q1G
  packet: packets/IB_2009_P2_q1G.md
  rework: rework/IB_2009_P2_q1G.md
- id: IB/2008/P2/q1E
  unit_dir: tripos/IB/2008/P2/q1E
  packet: packets/IB_2008_P2_q1E.md
  rework: rework/IB_2008_P2_q1E.md
- id: IB/2004/P3/q1E
  unit_dir: tripos/IB/2004/P3/q1E
  packet: packets/IB_2004_P3_q1E.md
  rework: rework/IB_2004_P3_q1E.md
- id: IB/2016/P4/q1F
  unit_dir: tripos/IB/2016/P4/q1F
  packet: packets/IB_2016_P4_q1F.md
  rework: rework/IB_2016_P4_q1F.md
- id: IB/2001/P4/q6C
  unit_dir: tripos/IB/2001/P4/q6C
  packet: packets/IB_2001_P4_q6C.md
  rework: rework/IB_2001_P4_q6C.md
- id: IB/2019/P3/q10F
  unit_dir: tripos/IB/2019/P3/q10F
  packet: packets/IB_2019_P3_q10F.md
  rework: rework/IB_2019_P3_q10F.md
- id: IB/2006/P1/q1H
  unit_dir: tripos/IB/2006/P1/q1H
  packet: packets/IB_2006_P1_q1H.md
  rework: rework/IB_2006_P1_q1H.md
- id: IB/2002/P3/q17F
  unit_dir: tripos/IB/2002/P3/q17F
  packet: packets/IB_2002_P3_q17F.md
  rework: rework/IB_2002_P3_q17F.md
- id: IB/2001/P2/q6C
  unit_dir: tripos/IB/2001/P2/q6C
  packet: packets/IB_2001_P2_q6C.md
  rework: rework/IB_2001_P2_q6C.md
- id: IB/2008/P2/q10E
  unit_dir: tripos/IB/2008/P2/q10E
  packet: packets/IB_2008_P2_q10E.md
  rework: rework/IB_2008_P2_q10E.md
- id: IB/2019/P4/q10F
  unit_dir: tripos/IB/2019/P4/q10F
  packet: packets/IB_2019_P4_q10F.md
  rework: rework/IB_2019_P4_q10F.md
- id: IB/2024/P4/q1G
  unit_dir: tripos/IB/2024/P4/q1G
  packet: packets/IB_2024_P4_q1G.md
  rework: rework/IB_2024_P4_q1G.md
- id: IB/2005/P3/q10B
  unit_dir: tripos/IB/2005/P3/q10B
  packet: packets/IB_2005_P3_q10B.md
  rework: rework/IB_2005_P3_q10B.md
- id: IB/2012/P4/q1F
  unit_dir: tripos/IB/2012/P4/q1F
  packet: packets/IB_2012_P4_q1F.md
  rework: rework/IB_2012_P4_q1F.md
- id: IB/2022/P1/q8F
  unit_dir: tripos/IB/2022/P1/q8F
  packet: packets/IB_2022_P1_q8F.md
  rework: rework/IB_2022_P1_q8F.md
- id: IB/2018/P2/q1E
  unit_dir: tripos/IB/2018/P2/q1E
  packet: packets/IB_2018_P2_q1E.md
  rework: rework/IB_2018_P2_q1E.md
```
