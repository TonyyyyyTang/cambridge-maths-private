## audits/markov-course-2026-11/sample.yaml
```yaml
course: IB/markov-chains
population: 141
seed: 20261122
method: random.Random(seed).sample per stratum (sheet, tripos), each ceil(20%), population
  sorted by id
sample:
- id: IB/markov-chains/sheet-2/q11
  unit_dir: courses/IB/markov-chains/sheets/sheet-2/q11
  packet: packets/IB_markov-chains_sheet-2_q11.md
  rework: rework/IB_markov-chains_sheet-2_q11.md
- id: IB/markov-chains/sheet-2/q07
  unit_dir: courses/IB/markov-chains/sheets/sheet-2/q07
  packet: packets/IB_markov-chains_sheet-2_q07.md
  rework: rework/IB_markov-chains_sheet-2_q07.md
- id: IB/markov-chains/sheet-1/qx03
  unit_dir: courses/IB/markov-chains/sheets/sheet-1/qx03
  packet: packets/IB_markov-chains_sheet-1_qx03.md
  rework: rework/IB_markov-chains_sheet-1_qx03.md
- id: IB/markov-chains/sheet-2/q15
  unit_dir: courses/IB/markov-chains/sheets/sheet-2/q15
  packet: packets/IB_markov-chains_sheet-2_q15.md
  rework: rework/IB_markov-chains_sheet-2_q15.md
- id: IB/markov-chains/sheet-1/qx12
  unit_dir: courses/IB/markov-chains/sheets/sheet-1/qx12
  packet: packets/IB_markov-chains_sheet-1_qx12.md
  rework: rework/IB_markov-chains_sheet-1_qx12.md
- id: IB/markov-chains/sheet-2/qx01
  unit_dir: courses/IB/markov-chains/sheets/sheet-2/qx01
  packet: packets/IB_markov-chains_sheet-2_qx01.md
  rework: rework/IB_markov-chains_sheet-2_qx01.md
- id: IB/markov-chains/sheet-2/q14
  unit_dir: courses/IB/markov-chains/sheets/sheet-2/q14
  packet: packets/IB_markov-chains_sheet-2_q14.md
  rework: rework/IB_markov-chains_sheet-2_q14.md
- id: IB/markov-chains/sheet-1/q03
  unit_dir: courses/IB/markov-chains/sheets/sheet-1/q03
  packet: packets/IB_markov-chains_sheet-1_q03.md
  rework: rework/IB_markov-chains_sheet-1_q03.md
- id: IB/markov-chains/sheet-1/q04
  unit_dir: courses/IB/markov-chains/sheets/sheet-1/q04
  packet: packets/IB_markov-chains_sheet-1_q04.md
  rework: rework/IB_markov-chains_sheet-1_q04.md
- id: IB/markov-chains/sheet-2/qx06
  unit_dir: courses/IB/markov-chains/sheets/sheet-2/qx06
  packet: packets/IB_markov-chains_sheet-2_qx06.md
  rework: rework/IB_markov-chains_sheet-2_qx06.md
- id: IB/markov-chains/sheet-2/qx05
  unit_dir: courses/IB/markov-chains/sheets/sheet-2/qx05
  packet: packets/IB_markov-chains_sheet-2_qx05.md
  rework: rework/IB_markov-chains_sheet-2_qx05.md
- id: IB/2004/P2/q11H
  unit_dir: tripos/IB/2004/P2/q11H
  packet: packets/IB_2004_P2_q11H.md
  rework: rework/IB_2004_P2_q11H.md
- id: IB/2009/P2/q20H
  unit_dir: tripos/IB/2009/P2/q20H
  packet: packets/IB_2009_P2_q20H.md
  rework: rework/IB_2009_P2_q20H.md
- id: IB/2017/P4/q9H
  unit_dir: tripos/IB/2017/P4/q9H
  packet: packets/IB_2017_P4_q9H.md
  rework: rework/IB_2017_P4_q9H.md
- id: IB/2019/P4/q9H
  unit_dir: tripos/IB/2019/P4/q9H
  packet: packets/IB_2019_P4_q9H.md
  rework: rework/IB_2019_P4_q9H.md
- id: IB/2011/P2/q20H
  unit_dir: tripos/IB/2011/P2/q20H
  packet: packets/IB_2011_P2_q20H.md
  rework: rework/IB_2011_P2_q20H.md
- id: IB/2024/P3/q8H
  unit_dir: tripos/IB/2024/P3/q8H
  packet: packets/IB_2024_P3_q8H.md
  rework: rework/IB_2024_P3_q8H.md
- id: IB/2015/P3/q9H
  unit_dir: tripos/IB/2015/P3/q9H
  packet: packets/IB_2015_P3_q9H.md
  rework: rework/IB_2015_P3_q9H.md
- id: IB/2013/P3/q9H
  unit_dir: tripos/IB/2013/P3/q9H
  packet: packets/IB_2013_P3_q9H.md
  rework: rework/IB_2013_P3_q9H.md
- id: IB/2016/P4/q9H
  unit_dir: tripos/IB/2016/P4/q9H
  packet: packets/IB_2016_P4_q9H.md
  rework: rework/IB_2016_P4_q9H.md
- id: IB/2021/P2/q18H
  unit_dir: tripos/IB/2021/P2/q18H
  packet: packets/IB_2021_P2_q18H.md
  rework: rework/IB_2021_P2_q18H.md
- id: IB/2012/P2/q20H
  unit_dir: tripos/IB/2012/P2/q20H
  packet: packets/IB_2012_P2_q20H.md
  rework: rework/IB_2012_P2_q20H.md
- id: IB/2026/P3/q8H
  unit_dir: tripos/IB/2026/P3/q8H
  packet: packets/IB_2026_P3_q8H.md
  rework: rework/IB_2026_P3_q8H.md
- id: IB/2021/P1/q19H
  unit_dir: tripos/IB/2021/P1/q19H
  packet: packets/IB_2021_P1_q19H.md
  rework: rework/IB_2021_P1_q19H.md
- id: IB/2019/P1/q20H
  unit_dir: tripos/IB/2019/P1/q20H
  packet: packets/IB_2019_P1_q20H.md
  rework: rework/IB_2019_P1_q20H.md
- id: IB/2013/P1/q20H
  unit_dir: tripos/IB/2013/P1/q20H
  packet: packets/IB_2013_P1_q20H.md
  rework: rework/IB_2013_P1_q20H.md
- id: IB/2014/P4/q9H
  unit_dir: tripos/IB/2014/P4/q9H
  packet: packets/IB_2014_P4_q9H.md
  rework: rework/IB_2014_P4_q9H.md
- id: IB/2008/P2/q20H
  unit_dir: tripos/IB/2008/P2/q20H
  packet: packets/IB_2008_P2_q20H.md
  rework: rework/IB_2008_P2_q20H.md
- id: IB/2016/P3/q9H
  unit_dir: tripos/IB/2016/P3/q9H
  packet: packets/IB_2016_P3_q9H.md
  rework: rework/IB_2016_P3_q9H.md
```

## audits/methods-course-2026-11/sample.yaml
```yaml
course: IB/methods
population: 336
strata:
  sheet:
    population: 154
    sampled: 31
  tripos:
    population: 182
    sampled: 37
seed: 20261201
method: random.Random(seed).sample per stratum (sheet, then tripos), each ceil(20%),
  population sorted by id; population = ai-draft units with course or also_courses
  equal to the course
sample:
- id: IB/methods/sheet-1/qx25
  unit_dir: courses/IB/methods/sheets/sheet-1/qx25
  packet: packets/IB_methods_sheet-1_qx25.md
  rework: rework/IB_methods_sheet-1_qx25.md
- id: IB/methods/sheet-2/qx24
  unit_dir: courses/IB/methods/sheets/sheet-2/qx24
  packet: packets/IB_methods_sheet-2_qx24.md
  rework: rework/IB_methods_sheet-2_qx24.md
- id: IB/methods/sheet-1/qx27
  unit_dir: courses/IB/methods/sheets/sheet-1/qx27
  packet: packets/IB_methods_sheet-1_qx27.md
  rework: rework/IB_methods_sheet-1_qx27.md
- id: IB/methods/sheet-2/qx20
  unit_dir: courses/IB/methods/sheets/sheet-2/qx20
  packet: packets/IB_methods_sheet-2_qx20.md
  rework: rework/IB_methods_sheet-2_qx20.md
- id: IB/methods/sheet-2/qx10
  unit_dir: courses/IB/methods/sheets/sheet-2/qx10
  packet: packets/IB_methods_sheet-2_qx10.md
  rework: rework/IB_methods_sheet-2_qx10.md
- id: IB/methods/sheet-2/qx03
  unit_dir: courses/IB/methods/sheets/sheet-2/qx03
  packet: packets/IB_methods_sheet-2_qx03.md
  rework: rework/IB_methods_sheet-2_qx03.md
- id: IB/methods/sheet-1/qx06
  unit_dir: courses/IB/methods/sheets/sheet-1/qx06
  packet: packets/IB_methods_sheet-1_qx06.md
  rework: rework/IB_methods_sheet-1_qx06.md
- id: IB/methods/sheet-1/qx10
  unit_dir: courses/IB/methods/sheets/sheet-1/qx10
  packet: packets/IB_methods_sheet-1_qx10.md
  rework: rework/IB_methods_sheet-1_qx10.md
- id: IB/methods/sheet-2/qx19
  unit_dir: courses/IB/methods/sheets/sheet-2/qx19
  packet: packets/IB_methods_sheet-2_qx19.md
  rework: rework/IB_methods_sheet-2_qx19.md
- id: IB/methods/sheet-1/qx24
  unit_dir: courses/IB/methods/sheets/sheet-1/qx24
  packet: packets/IB_methods_sheet-1_qx24.md
  rework: rework/IB_methods_sheet-1_qx24.md
- id: IB/methods/sheet-3/qx05
  unit_dir: courses/IB/methods/sheets/sheet-3/qx05
  packet: packets/IB_methods_sheet-3_qx05.md
  rework: rework/IB_methods_sheet-3_qx05.md
- id: IB/methods/sheet-1/q10
  unit_dir: courses/IB/methods/sheets/sheet-1/q10
  packet: packets/IB_methods_sheet-1_q10.md
  rework: rework/IB_methods_sheet-1_q10.md
- id: IB/methods/sheet-4/q09
  unit_dir: courses/IB/methods/sheets/sheet-4/q09
  packet: packets/IB_methods_sheet-4_q09.md
  rework: rework/IB_methods_sheet-4_q09.md
- id: IB/methods/sheet-2/qx05
  unit_dir: courses/IB/methods/sheets/sheet-2/qx05
  packet: packets/IB_methods_sheet-2_qx05.md
  rework: rework/IB_methods_sheet-2_qx05.md
- id: IB/methods/sheet-1/qx13
  unit_dir: courses/IB/methods/sheets/sheet-1/qx13
  packet: packets/IB_methods_sheet-1_qx13.md
  rework: rework/IB_methods_sheet-1_qx13.md
- id: IB/methods/sheet-3/q12
  unit_dir: courses/IB/methods/sheets/sheet-3/q12
  packet: packets/IB_methods_sheet-3_q12.md
  rework: rework/IB_methods_sheet-3_q12.md
- id: IB/methods/sheet-4/qx28
  unit_dir: courses/IB/methods/sheets/sheet-4/qx28
  packet: packets/IB_methods_sheet-4_qx28.md
  rework: rework/IB_methods_sheet-4_qx28.md
- id: IB/methods/sheet-3/qx07
  unit_dir: courses/IB/methods/sheets/sheet-3/qx07
  packet: packets/IB_methods_sheet-3_qx07.md
  rework: rework/IB_methods_sheet-3_qx07.md
- id: IB/methods/sheet-2/qx25
  unit_dir: courses/IB/methods/sheets/sheet-2/qx25
  packet: packets/IB_methods_sheet-2_qx25.md
  rework: rework/IB_methods_sheet-2_qx25.md
- id: IB/methods/sheet-3/qx24
  unit_dir: courses/IB/methods/sheets/sheet-3/qx24
  packet: packets/IB_methods_sheet-3_qx24.md
  rework: rework/IB_methods_sheet-3_qx24.md
- id: IB/methods/sheet-4/q12
  unit_dir: courses/IB/methods/sheets/sheet-4/q12
  packet: packets/IB_methods_sheet-4_q12.md
  rework: rework/IB_methods_sheet-4_q12.md
- id: IB/methods/sheet-1/qx16
  unit_dir: courses/IB/methods/sheets/sheet-1/qx16
  packet: packets/IB_methods_sheet-1_qx16.md
  rework: rework/IB_methods_sheet-1_qx16.md
- id: IB/methods/sheet-4/qx10
  unit_dir: courses/IB/methods/sheets/sheet-4/qx10
  packet: packets/IB_methods_sheet-4_qx10.md
  rework: rework/IB_methods_sheet-4_qx10.md
- id: IB/methods/sheet-3/qx16
  unit_dir: courses/IB/methods/sheets/sheet-3/qx16
  packet: packets/IB_methods_sheet-3_qx16.md
  rework: rework/IB_methods_sheet-3_qx16.md
- id: IB/methods/sheet-4/q05
  unit_dir: courses/IB/methods/sheets/sheet-4/q05
  packet: packets/IB_methods_sheet-4_q05.md
  rework: rework/IB_methods_sheet-4_q05.md
- id: IB/methods/sheet-1/q08
  unit_dir: courses/IB/methods/sheets/sheet-1/q08
  packet: packets/IB_methods_sheet-1_q08.md
  rework: rework/IB_methods_sheet-1_q08.md
- id: IB/methods/sheet-3/q03
  unit_dir: courses/IB/methods/sheets/sheet-3/q03
  packet: packets/IB_methods_sheet-3_q03.md
  rework: rework/IB_methods_sheet-3_q03.md
- id: IB/methods/sheet-1/qx28
  unit_dir: courses/IB/methods/sheets/sheet-1/qx28
  packet: packets/IB_methods_sheet-1_qx28.md
  rework: rework/IB_methods_sheet-1_qx28.md
- id: IB/methods/sheet-4/qx02
  unit_dir: courses/IB/methods/sheets/sheet-4/qx02
  packet: packets/IB_methods_sheet-4_qx02.md
  rework: rework/IB_methods_sheet-4_qx02.md
- id: IB/methods/sheet-4/q03
  unit_dir: courses/IB/methods/sheets/sheet-4/q03
  packet: packets/IB_methods_sheet-4_q03.md
  rework: rework/IB_methods_sheet-4_q03.md
- id: IB/methods/sheet-1/qx12
  unit_dir: courses/IB/methods/sheets/sheet-1/qx12
  packet: packets/IB_methods_sheet-1_qx12.md
  rework: rework/IB_methods_sheet-1_qx12.md
- id: IB/2015/P1/q14C
  unit_dir: tripos/IB/2015/P1/q14C
  packet: packets/IB_2015_P1_q14C.md
  rework: rework/IB_2015_P1_q14C.md
- id: IB/2001/P4/q2H
  unit_dir: tripos/IB/2001/P4/q2H
  packet: packets/IB_2001_P4_q2H.md
  rework: rework/IB_2001_P4_q2H.md
- id: IB/2014/P2/q16D
  unit_dir: tripos/IB/2014/P2/q16D
  packet: packets/IB_2014_P2_q16D.md
  rework: rework/IB_2014_P2_q16D.md
- id: IB/2023/P2/q14A
  unit_dir: tripos/IB/2023/P2/q14A
  packet: packets/IB_2023_P2_q14A.md
  rework: rework/IB_2023_P2_q14A.md
- id: IB/2012/P1/q14C
  unit_dir: tripos/IB/2012/P1/q14C
  packet: packets/IB_2012_P1_q14C.md
  rework: rework/IB_2012_P1_q14C.md
- id: IB/2006/P1/q14A
  unit_dir: tripos/IB/2006/P1/q14A
  packet: packets/IB_2006_P1_q14A.md
  rework: rework/IB_2006_P1_q14A.md
- id: IB/2010/P4/q17B
  unit_dir: tripos/IB/2010/P4/q17B
  packet: packets/IB_2010_P4_q17B.md
  rework: rework/IB_2010_P4_q17B.md
- id: IB/2017/P3/q15A
  unit_dir: tripos/IB/2017/P3/q15A
  packet: packets/IB_2017_P3_q15A.md
  rework: rework/IB_2017_P3_q15A.md
- id: IB/2004/P2/q6B
  unit_dir: tripos/IB/2004/P2/q6B
  packet: packets/IB_2004_P2_q6B.md
  rework: rework/IB_2004_P2_q6B.md
- id: IB/2005/P2/q5E
  unit_dir: tripos/IB/2005/P2/q5E
  packet: packets/IB_2005_P2_q5E.md
  rework: rework/IB_2005_P2_q5E.md
- id: IB/2018/P1/q14C
  unit_dir: tripos/IB/2018/P1/q14C
  packet: packets/IB_2018_P1_q14C.md
  rework: rework/IB_2018_P1_q14C.md
- id: IB/2013/P2/q5B
  unit_dir: tripos/IB/2013/P2/q5B
  packet: packets/IB_2013_P2_q5B.md
  rework: rework/IB_2013_P2_q5B.md
- id: IB/2023/P3/q14A
  unit_dir: tripos/IB/2023/P3/q14A
  packet: packets/IB_2023_P3_q14A.md
  rework: rework/IB_2023_P3_q14A.md
- id: IB/2011/P2/q5A
  unit_dir: tripos/IB/2011/P2/q5A
  packet: packets/IB_2011_P2_q5A.md
  rework: rework/IB_2011_P2_q5A.md
- id: IB/2014/P1/q14D
  unit_dir: tripos/IB/2014/P1/q14D
  packet: packets/IB_2014_P1_q14D.md
  rework: rework/IB_2014_P1_q14D.md
- id: IB/2006/P2/q15G
  unit_dir: tripos/IB/2006/P2/q15G
  packet: packets/IB_2006_P2_q15G.md
  rework: rework/IB_2006_P2_q15G.md
- id: IB/2007/P2/q15D
  unit_dir: tripos/IB/2007/P2/q15D
  packet: packets/IB_2007_P2_q15D.md
  rework: rework/IB_2007_P2_q15D.md
- id: IB/2018/P2/q16A
  unit_dir: tripos/IB/2018/P2/q16A
  packet: packets/IB_2018_P2_q16A.md
  rework: rework/IB_2018_P2_q16A.md
- id: IB/2005/P4/q5H
  unit_dir: tripos/IB/2005/P4/q5H
  packet: packets/IB_2005_P4_q5H.md
  rework: rework/IB_2005_P4_q5H.md
- id: IB/2009/P3/q15A
  unit_dir: tripos/IB/2009/P3/q15A
  packet: packets/IB_2009_P3_q15A.md
  rework: rework/IB_2009_P3_q15A.md
- id: IB/2014/P2/q5D
  unit_dir: tripos/IB/2014/P2/q5D
  packet: packets/IB_2014_P2_q5D.md
  rework: rework/IB_2014_P2_q5D.md
- id: IB/2014/P3/q7D
  unit_dir: tripos/IB/2014/P3/q7D
  packet: packets/IB_2014_P3_q7D.md
  rework: rework/IB_2014_P3_q7D.md
- id: IB/2008/P1/q14D
  unit_dir: tripos/IB/2008/P1/q14D
  packet: packets/IB_2008_P1_q14D.md
  rework: rework/IB_2008_P1_q14D.md
- id: IB/2019/P3/q15D
  unit_dir: tripos/IB/2019/P3/q15D
  packet: packets/IB_2019_P3_q15D.md
  rework: rework/IB_2019_P3_q15D.md
- id: IB/2021/P2/q3C
  unit_dir: tripos/IB/2021/P2/q3C
  packet: packets/IB_2021_P2_q3C.md
  rework: rework/IB_2021_P2_q3C.md
- id: IB/2004/P3/q6D
  unit_dir: tripos/IB/2004/P3/q6D
  packet: packets/IB_2004_P3_q6D.md
  rework: rework/IB_2004_P3_q6D.md
- id: IB/2019/P2/q16D
  unit_dir: tripos/IB/2019/P2/q16D
  packet: packets/IB_2019_P2_q16D.md
  rework: rework/IB_2019_P2_q16D.md
- id: IB/2009/P4/q5B
  unit_dir: tripos/IB/2009/P4/q5B
  packet: packets/IB_2009_P4_q5B.md
  rework: rework/IB_2009_P4_q5B.md
- id: IB/2016/P3/q15B
  unit_dir: tripos/IB/2016/P3/q15B
  packet: packets/IB_2016_P3_q15B.md
  rework: rework/IB_2016_P3_q15B.md
- id: IB/2002/P2/q11C
  unit_dir: tripos/IB/2002/P2/q11C
  packet: packets/IB_2002_P2_q11C.md
  rework: rework/IB_2002_P2_q11C.md
- id: IB/2007/P4/q16E
  unit_dir: tripos/IB/2007/P4/q16E
  packet: packets/IB_2007_P4_q16E.md
  rework: rework/IB_2007_P4_q16E.md
- id: IB/2011/P1/q14A
  unit_dir: tripos/IB/2011/P1/q14A
  packet: packets/IB_2011_P1_q14A.md
  rework: rework/IB_2011_P1_q14A.md
- id: IB/2004/P2/q17B
  unit_dir: tripos/IB/2004/P2/q17B
  packet: packets/IB_2004_P2_q17B.md
  rework: rework/IB_2004_P2_q17B.md
- id: IB/2003/P2/q11C
  unit_dir: tripos/IB/2003/P2/q11C
  packet: packets/IB_2003_P2_q11C.md
  rework: rework/IB_2003_P2_q11C.md
- id: IB/2018/P4/q5A
  unit_dir: tripos/IB/2018/P4/q5A
  packet: packets/IB_2018_P4_q5A.md
  rework: rework/IB_2018_P4_q5A.md
- id: IB/2020/P2/q13A
  unit_dir: tripos/IB/2020/P2/q13A
  packet: packets/IB_2020_P2_q13A.md
  rework: rework/IB_2020_P2_q13A.md
- id: IB/2024/P3/q5B
  unit_dir: tripos/IB/2024/P3/q5B
  packet: packets/IB_2024_P3_q5B.md
  rework: rework/IB_2024_P3_q5B.md
```
